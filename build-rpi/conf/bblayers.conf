## build-rpi/conf/bblayers.conf
```bitbake
# POKY_BBLAYERS_CONF_VERSION is increased each time build/conf/bblayers.conf
# changes incompatibly
POKY_BBLAYERS_CONF_VERSION = "2"

BBPATH = "${TOPDIR}"
BBFILES ?= ""

BBLAYERS ?= " \
  /home/zusak/Inzynierka/poky/meta \
  /home/zusak/Inzynierka/poky/meta-poky \
  /home/zusak/Inzynierka/poky/meta-yocto-bsp \
  /home/zusak/Inzynierka/poky/meta-raspberrypi \
  /home/zusak/Inzynierka/poky/meta-openembedded/meta-oe \
  /home/zusak/Inzynierka/poky/meta-openembedded/meta-networking \
  /home/zusak/Inzynierka/poky/meta-openembedded/meta-multimedia \
  /home/zusak/Inzynierka/poky/meta-openembedded/meta-python \
  /home/zusak/Inzynierka/poky/meta-customapplication \
  "
```

## meta-customapplication/conf/layer.conf
```bitbake
# We have a conf and classes directory, add to BBPATH
BBPATH .= ":${LAYERDIR}"

# We have recipes-* directories, add to BBFILES
BBFILES += "${LAYERDIR}/recipes-*/*/*.bb \
            ${LAYERDIR}/recipes-*/*/*.bbappend"

BBFILE_COLLECTIONS += "meta-customapplication"
BBFILE_PATTERN_meta-customapplication = "^${LAYERDIR}/"
BBFILE_PRIORITY_meta-customapplication = "6"

LAYERDEPENDS_meta-customapplication = "core"
LAYERSERIES_COMPAT_meta-customapplication = "warrior zeus"
```
